## archive/nrf24-experiment/Kconfig.projbuild
```kconfig
menu "Scanner Hardware Options"

    config SCANNER_NRF24
        bool "Enable NRF24L01 2.4 GHz radio support"
        default n
        help
            Enable optional NRF24L01 2.4 GHz radio support for the scanner.
            When enabled, the firmware initializes an NRF24L01 module on the
            ESP32 VSPI pins and exposes a full-band spectrum scan API. Leave
            this disabled for scanner builds that do not have NRF24 hardware
            attached.

endmenu
```

## firmware/crowpanel/sdkconfig.defaults
```kconfig
CONFIG_SPIRAM=y
CONFIG_SPIRAM_MODE_OCT=y
CONFIG_SPIRAM_SPEED_80M=y
CONFIG_SPIRAM_BOOT_INIT=y
CONFIG_SPIRAM_USE_MALLOC=y
CONFIG_SPIRAM_ALLOW_BSS_SEG_EXTERNAL_MEMORY=y
CONFIG_ESPTOOLPY_FLASHSIZE_16MB=y
CONFIG_SPI_MASTER_ISR_IN_IRAM=y
CONFIG_LOG_DEFAULT_LEVEL_INFO=y
CONFIG_IDF_TARGET="esp32s3"
CONFIG_IDF_TARGET_ESP32S3=y
CONFIG_ESP_MAIN_TASK_STACK_SIZE=8192
```

## firmware/esp32_avrcp_console/sdkconfig.defaults
```kconfig
CONFIG_BT_ENABLED=y
CONFIG_BT_BLUEDROID_ENABLED=y
CONFIG_BT_CLASSIC_ENABLED=y
CONFIG_BT_L2CAP_ENABLED=y
CONFIG_BTDM_CTRL_MODE_BTDM=y
```
